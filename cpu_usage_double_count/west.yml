## cpu_usage_double_count/west.yml
```yaml
manifest:
  remotes:
    - name: upstream
      url-base: https://github.com/zephyrproject-rtos

  defaults:
    remote: upstream

  projects:
    - name: zephyr
      revision: 0d65ce46dda0626164503c50f37e6e1f59d310a9  # 2026-08-12 00:56:21 +0000

  self:
    path: cpu_usage_double_count
```

## log_timestamp_trunc/west.yml
```yaml
manifest:
  remotes:
    - name: upstream
      url-base: https://github.com/zephyrproject-rtos

  defaults:
    remote: upstream

  projects:
    - name: zephyr
      revision: 93db4e5dfc8ad37286a97dc5f2c1785aab3f3165  # 2026-08-19 22:43:40 +0000

  self:
    path: log_timestamp_trunc
```

## noop_macro_cause_unused_var/west.yml
```yaml
manifest:
  remotes:
    - name: upstream
      url-base: https://github.com/zephyrproject-rtos

  defaults:
    remote: upstream

  projects:
    - name: zephyr
      revision: 0f0408617f65e38b2b2f86b69a68576a3f21c253  # 2026-08-17 08:27:42 +0000

  self:
    path: noop_macro_cause_unused_var
```

## stack_canaries_tls/west.yml
```yaml
manifest:
  remotes:
    - name: upstream
      url-base: https://github.com/zephyrproject-rtos

  defaults:
    remote: upstream

  projects:
    - name: zephyr
      revision: 161f758ba363ec90cd9b727a5d82e6c86efa85ad  # 2026-08-12 23:28:04 +0000

  self:
    path: stack_canaries_tls
```

## video_buf_null_deref/west.yml
```yaml
manifest:
  remotes:
    - name: upstream
      url-base: https://github.com/zephyrproject-rtos

  defaults:
    remote: upstream

  projects:
    - name: zephyr
      revision: d698ef5a7277c6824df0647a8b46e8cc79ef3ece  # 2026-08-19 00:41:33 +0000

  self:
    path: video_buf_null_deref
```
